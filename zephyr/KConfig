## zephyr/KConfig
```kconfig
# Copyright (c) 2023 Faust Network, Inc

config ST25DV
	bool "Enable st25dv driver"
	help
	  This option enables the st25dv driver library as a Zephyr module.
```

## zephyr/Kconfig.libst25dv
```kconfig
# Copyright (c) 2023 Faust Network, Inc

config LIBST25DV
	bool "Enable st25dv driver"
	help
	  This option enables the st25dv driver library as a Zephyr module.
```
